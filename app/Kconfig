## app/dts/bindings/behaviors/zmk,behavior-display-navigation.yaml
```yaml
description: Display Navigation Behavior

compatible: "zmk,behavior-display-navigation"

include: one_param.yaml
```

## app/src/rgb/Kconfig
```kconfig
menu "Extra RGB config"

menuconfig RGB_LIGHTING
    bool "RGB Adressable LED"
    select LED_STRIP

if RGB_LIGHTING

config RGB_REFRESH_MS
	int "refresh rate"
	default 25

config RGB_TRANSITION_DURATION_START
	int "duration of transition between colors or effects"
	default 100

config RGB_TRANSITION_DURATION_STEP
	int "duration of transition between colors or effects"
	default 50


# This default value cuts down on tons of excess .conf files, if you're using GPIO, manually disable this
config SPI
    default y

config ZMK_RGB_UNDERGLOW_EXT_POWER
    bool "RGB underglow toggling also controls external power"
    default y

config ZMK_RGB_UNDERGLOW_BRT_MIN
    int "RGB underglow minimum brightness in percent"
    range 0 100
    default 0

config ZMK_RGB_UNDERGLOW_BRT_MAX
    int "RGB underglow maximum brightness in percent"
    range ZMK_RGB_UNDERGLOW_BRT_MIN 100
    default 100

config ZMK_RGB_UNDERGLOW_HUE_STEP
    int "RGB underglow hue step in degrees"
    range 0 359
    default 10

config ZMK_RGB_UNDERGLOW_SAT_STEP
    int "RGB underglow saturation step in percent"
    range 0 100
    default 10

config ZMK_RGB_UNDERGLOW_BRT_STEP
    int "RGB underglow brightness step in percent"
    range 0 100
    default 10

config ZMK_RGB_UNDERGLOW_HUE_START
    int "RGB underglow start hue value in degrees"
    range 0 359
    default 0

config ZMK_RGB_UNDERGLOW_SAT_START
    int "RGB underglow start saturations value in percent"
    range 0 100
    default 100

config ZMK_RGB_UNDERGLOW_BRT_START
    int "RGB underglow start brightness value in percent"
    range ZMK_RGB_UNDERGLOW_BRT_MIN ZMK_RGB_UNDERGLOW_BRT_MAX
    default ZMK_RGB_UNDERGLOW_BRT_MAX

config ZMK_RGB_UNDERGLOW_SPD_START
    int "RGB underglow start animation speed value"
    range 1 5
    default 3

config ZMK_RGB_UNDERGLOW_EFF_START
    int "RGB underglow start effect int value related to the effect enum list"
    range 0 3
    default 0

config ZMK_RGB_UNDERGLOW_ON_START
	# bool "RGB Adressable LED Underglow"
	select LED_STRIP
    bool "RGB underglow starts on by default"
    default y

config ZMK_RGB_UNDERGLOW_AUTO_OFF_IDLE
    bool "Turn off RGB underglow when keyboard goes into idle state"

config ZMK_RGB_UNDERGLOW_AUTO_OFF_USB
    bool "Turn off RGB underglow when USB is disconnected"
    depends on USB_DEVICE_STACK


#RGB_LIGHTING
endif

endmenu
```

## config/boards/shields/kyria/Kconfig.defconfig
```kconfig
if SHIELD_KYRIA_LEFT || SHIELD_KYRIA_REV2_LEFT || SHIELD_KYRIA_REV3_LEFT
	config ZMK_SPLIT_ROLE_CENTRAL
		default y
endif

if SHIELD_KYRIA
	config ZMK_SPLIT
		default y
	config ZMK_KEYBOARD_NAME
		default "Kyria"

	if ZMK_DISPLAY
		config I2C
			default y
		config SSD1306
			default y
		config SSD1306_REVERSE_MODE
			default y
	endif # ZMK_DISPLAY

	
	config ZMK_DISPLAY
		select LV_USE_CONT
		# select LV_FONT_MONTSERRAT_26
		# select LV_FONT_MONTSERRAT_16
		# select LV_OBJ_LABEL
		select LV_USE_LABEL
		select LV_USE_IMG
		select LV_USE_ANIMATION
		select LV_USE_THEME_MONO

	# menuconfig WIDGET_BONGO_CAT
	config WIDGET_BONGO_CAT
		bool "Widget for displaying bongo cat that reacts to typing"
		depends on !ZMK_SPLIT || ZMK_SPLIT_ROLE_CENTRAL

	config WIDGET_BATTERY_STATUS
		bool "custom battery status widget"

	config WIDGET_OUTPUT_STATUS
		bool "custom output status widget"

	config WIDGET_LAYER_STATUS
		bool "custom layer status widget"

	config WIDGET_PERIPHERAL_STATUS
		bool "custom peripheral status widget"


	if LVGL
		config LV_Z_VDB_SIZE
			default 64
		config LV_Z_DPI
			default 148
		config LV_Z_BITS_PER_PIXEL
			default 1
		choice LV_COLOR_DEPTH
			default LV_COLOR_DEPTH_1
		endchoice
	endif # LVGL

endif
```

## config/boards/shields/kyria/src/display/widgets/Kconfig
```kconfig
menu "Display Widgets"

config ZMK_DISPLAY
	select LV_USE_CONT
	select LV_USE_THEME_MONO
	select LV_FONT_UNSCII_8
	select LV_FONT_UNSCII_16
	select LV_FONT_MONTSERRAT_8
	select LV_FONT_MONTSERRAT_10
	select LV_FONT_MONTSERRAT_14
	select LV_FONT_MONTSERRAT_16
	select LV_FONT_MONTSERRAT_12_SUBPX
	select LV_FONT_MONTSERRAT_28_COMPRESSED
	select LV_FONT_SIMSUN_16_CJK
	# select LV_OBJ_LABEL


config WIDGET_LAYER_STATUS
	bool "Widget for highest, active layer using small icons"
	depends on !ZMK_SPLIT || ZMK_SPLIT_ROLE_CENTRAL
	select LV_USE_LABEL


config WIDGET_OUTPUT_STATUS
	bool "Widget for keyboard output status icons"
	depends on BT && (!ZMK_SPLIT_BLE || ZMK_SPLIT_ROLE_CENTRAL)
	select LV_USE_LABEL


config WIDGET_BONGO_CAT
# menuconfig WIDGET_BONGO_CAT
	bool "Widget for displaying bongo cat that reacts to typing"
	depends on (!ZMK_SPLIT || ZMK_SPLIT_ROLE_CENTRAL) # !ZMK_DISPLAY_WORK_QUEUE_DEDICATED
	select LV_USE_IMG
	select LV_USE_LABEL
	select LV_USE_ANIMATION


config WIDGET_MENU
	bool "Widget for displaying a menu which displays selectable items"
	select LV_USE_ROLLER
	select LV_USE_LINE
	select LV_USE_IMG
	select LV_USE_ANIMATION
	select LV_USE_BTN
	select LV_USE_FLEX


config WIDGET_BATTERY_STATUS
	bool "Widget for battery charge information, using small icons"
	depends on BT
	select LV_USE_LABEL

	if WIDGET_BATTERY_STATUS
		config WIDGET_BATTERY_STATUS_SHOW_PERCENTAGE
			bool "Show battery level percentage in text"
	endif


config WIDGET_PERIPHERAL_STATUS
	bool "Widget for split peripheral status icons"
	depends on BT && ZMK_SPLIT_BLE && !ZMK_SPLIT_ROLE_CENTRAL
	select LV_USE_IMG
	select LV_USE_LABEL


config WIDGET_WPM_STATUS
	bool "Widget for displaying typed words per minute"
	depends on !ZMK_SPLIT || ZMK_SPLIT_ROLE_CENTRAL
	select LV_USE_LABEL
	select ZMK_WPM

endmenu
```

## config_mine/west.yml
```yaml
manifest:
  remotes:
    - name: zmkfirmware
      url-base: https://github.com/zmkfirmware
    - name: stephen
      url-base: https://github.com/stephen
    - name: petejohanson
      url-base: https://github.com/petejohanson
  projects:
    - name: zmk
      remote: zmkfirmware
      revision: main
      # remote: stephen
      # revision: stephen/spit-encoder
      # remote: petejohanson
      # revision: shields/kyria-rev3
      import: app/west.yml
  self:
    path: config
```
