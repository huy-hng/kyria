/ {
    keymap {
        vim {
			label = "Vim";
			sensor-bindings = <&inc_dec_kp RIGHT LEFT>;
			bindings = <
//                ┌──────┬──────┬──────┬──────┬──────┬──────┐                               ┌───────┬────────┬────────┬────────┬──────┬──────┐
//                │ ____ │ _oo_ │   7  │   8  │   9  │ _oo_ │                               │  HOME │  PG_DN │  PG_UP │   END  │ _oo_ │ ____ │
//                ├──────┼──────┼──────┼──────┼──────┼──────┤                               ├───────┼────────┼────────┼────────┼──────┼──────┤
//                │ ____ │   0  │   4  │   5  │   6  │ _oo_ │                               │  LEFT │  DOWN  │   UP   │  RIGHT │ _oo_ │ ____ │
//                ├──────┼──────┼──────┼──────┼──────┼──────┼──────┬──────┐   ┌──────┬──────┼───────┼────────┼────────┼────────┼──────┼──────┤
//                │ ____ │   0  │   1  │   2  │   3  │ _oo_ │ ____ │ ____ │   │ ____ │ ____ │ _oo_  │  _oo_  │  _oo_  │  _oo_  │ _oo_ │ ____ │
//                └──────┴──────┴──────┼──────┼──────┼──────┼──────┼──────┤   ├──────┼──────┼───────┼────────┼────────┼────────┴──────┴──────┘
//                                     │ ____ │ ____ │ ____ │ ____ │ ____ │   │ ____ │ ____ │ ____  │  ____  │  ____  │                       
//                                     └──────┴──────┴──────┴──────┴──────┘   └──────┴──────┴───────┴────────┴────────┘                       
              ____   _oo_        &kp KP_N7   &kp KP_N8   &kp KP_N9   _oo_                                   &kp HOME   &kp PG_DN   &kp PG_UP   &kp END     _oo_   ____
              ____   &kp KP_N0   &kp KP_N4   &kp KP_N5   &kp KP_N6   _oo_                                   &kp LEFT   &kp DOWN    &kp UP      &kp RIGHT   _oo_   ____
              ____   &kp KP_N0   &kp KP_N1   &kp KP_N2   &kp KP_N3   _oo_   ____   ____       ____   ____   _oo_       _oo_        _oo_        _oo_        _oo_   ____
                                             ____        ____        ____   ____   ____       ____   ____   ____       ____        ____                               
            >;
        };
//         vim {
// 			label = "Vim";
// 			sensor-bindings = <&inc_dec_kp RIGHT LEFT>;
// 			bindings = <
// //                ┌──────┬───────────┬───────────┬─────────┬────────────┬────────────┐                               ┌───────┬───────┬──────┬────────┬──────┬──────┐
// //                │ _oo_ │   _oo_    │   _oo_    │  K_COPY │   K_PASTE  │    _oo_    │                               │ _oo_  │ _oo_  │ _oo_ │  _oo_  │ _oo_ │ _oo_ │
// //                ├──────┼───────────┼───────────┼─────────┼────────────┼────────────┤                               ├───────┼───────┼──────┼────────┼──────┼──────┤
// //                │ _oo_ │  LC(LEFT) │  LC(LEFT) │  _oo_   │  LC(RIGHT) │  LC(RIGHT) │                               │  LEFT │  DOWN │  UP  │  RIGHT │ _oo_ │ _oo_ │
// //                ├──────┼───────────┼───────────┼─────────┼────────────┼────────────┼──────┬──────┐   ┌──────┬──────┼───────┼───────┼──────┼────────┼──────┼──────┤
// //                │ _oo_ │   _oo_    │   K_CUT   │  _oo_   │    _oo_    │    _oo_    │ ____ │ ____ │   │ ____ │ ____ │ _oo_  │ _oo_  │ _oo_ │  _oo_  │ _oo_ │ _oo_ │
// //                └──────┴───────────┴───────────┼─────────┼────────────┼────────────┼──────┼──────┤   ├──────┼──────┼───────┼───────┼──────┼────────┴──────┴──────┘
// //                                               │  ____   │    ____    │    ____    │ ____ │ ____ │   │ ____ │ ____ │ ____  │ ____  │ ____ │                       
// //                                               └─────────┴────────────┴────────────┴──────┴──────┘   └──────┴──────┴───────┴───────┴──────┘                       
//               _oo_   _oo_           _oo_           &kp K_COPY   &kp K_PASTE     _oo_                                            _oo_       _oo_       _oo_     _oo_        _oo_   _oo_
//               _oo_   &kp LC(LEFT)   &kp LC(LEFT)   _oo_         &kp LC(RIGHT)   &kp LC(RIGHT)                                   &kp LEFT   &kp DOWN   &kp UP   &kp RIGHT   _oo_   _oo_
//               _oo_   _oo_           &kp K_CUT      _oo_         _oo_            _oo_            ____   ____       ____   ____   _oo_       _oo_       _oo_     _oo_        _oo_   _oo_
//                                                    ____         ____            ____            ____   ____       ____   ____   ____       ____       ____                            
//             >;
//         };
    };
};
