/ {
	keymap {
		fn_keys {
			label = "FN+";
			bindings = <
//                ┌──────┬──────┬──────┬─────────────┬──────┬──────┐                               ┌──────┬───────────┬───────────┬──────┬──────┬──────┐
//                │  F13 │  F14 │  F15 │     F16     │  F17 │  F18 │                               │  F19 │    F20    │    F21    │  F22 │  F23 │  F24 │
//                ├──────┼──────┼──────┼─────────────┼──────┼──────┤                               ├──────┼───────────┼───────────┼──────┼──────┼──────┤
//                │  F1  │  F2  │  F3  │      F4     │  F5  │  F6  │                               │  F7  │     F8    │     F9    │  F10 │  F11 │  F12 │
//                ├──────┼──────┼──────┼─────────────┼──────┼──────┼──────┬──────┐   ┌──────┬──────┼──────┼───────────┼───────────┼──────┼──────┼──────┤
//                │ _oo_ │ _oo_ │ _oo_ │  C_CAPTIONS │ _oo_ │ _oo_ │ ____ │ ____ │   │ ____ │ ____ │ _oo_ │  C_BRI_DN │  C_BRI_UP │ ____ │ ____ │ ____ │
//                └──────┴──────┴──────┼─────────────┼──────┼──────┼──────┼──────┤   ├──────┼──────┼──────┼───────────┼───────────┼──────┴──────┴──────┘
//                                     │    ____     │ ____ │ ____ │ ____ │ ____ │   │ ____ │ ____ │ ____ │   ____    │   ____    │                     
//                                     └─────────────┴──────┴──────┴──────┴──────┘   └──────┴──────┴──────┴───────────┴───────────┘                     
              &kp F13   &kp F14   &kp F15   &kp F16          &kp F17   &kp F18                                   &kp F19   &kp F20        &kp F21        &kp F22   &kp F23   &kp F24
              &kp F1    &kp F2    &kp F3    &kp F4           &kp F5    &kp F6                                    &kp F7    &kp F8         &kp F9         &kp F10   &kp F11   &kp F12
              _oo_      _oo_      _oo_      &kp C_CAPTIONS   _oo_      _oo_      ____   ____       ____   ____   _oo_      &kp C_BRI_DN   &kp C_BRI_UP   ____      ____      ____   
                                            ____             ____      ____      ____   ____       ____   ____   ____      ____           ____                                      
			>;
		};
	};
};
