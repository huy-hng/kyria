#define win_bl kp LC(LA(KP_N1))
#define win_b  kp LC(LA(KP_N2))
#define win_br kp LC(LA(KP_N3))
#define win_l  kp LC(LA(KP_N4))
#define win_c  kp LC(LA(KP_N5))
#define win_r  kp LC(LA(KP_N6))
#define win_tl kp LC(LA(KP_N7))
#define win_t  kp LC(LA(KP_N8))
#define win_tr kp LC(LA(KP_N9))


// maybe this needs to be curly bracket instead of shift square bracket
#define chrome_win_desktop_left kp LG(LS(LBKT))
#define chrome_win_desktop_right kp LG(LS(RBKT))

#define chrome_win_switch_monitor kp LG(LA(M))


/ {
	keymap {
		os_layer {
			label = "OS";
			bindings = <
//                ╭─────┬─────────┬────────┬─────────┬─────────────┬─────╮                           ╭────────┬─────────┬─────────┬────────┬─────────┬────────╮
//                │     │ &win_tl │ &win_t │ &win_tr │     ---     │ --- │                           │ LG(N1) │ LG(N2)  │ LG(N3)  │ LG(N4) │ LG(N5)  │ LG(N6) │
//                ├─────┼─────────┼────────┼─────────┼─────────────┼─────┤                           ├────────┼─────────┼─────────┼────────┼─────────┼────────┤
//                │     │ &win_l  │ &win_c │ &win_r  │   LA( ⭾ )   │ --- │                           │ LG(H)  │  LG(J)  │  LG(K)  │ LG(L)  │ LG( ; ) │  ---   │
//                ├─────┼─────────┼────────┼─────────┼─────────────┼─────┼─────┬─────╮   ╭─────┬─────┼────────┼─────────┼─────────┼────────┼─────────┼────────┤
//                │     │ &win_bl │ &win_b │ &win_br │ LA(LS( ⭾ )) │ --- │     │     │   │     │     │  ---   │ LG( [ ) │ LG( ] ) │  ---   │   ---   │  ---   │
//                ╰─────┴─────────┴────────┼─────────┼─────────────┼─────┼─────┼─────┤   ├─────┼─────┼────────┼─────────┼─────────┼────────┴─────────┴────────╯
//                                         │         │             │     │     │     │   │     │     │        │         │         │                            
//                                         ╰─────────┴─────────────┴─────┴─────┴─────╯   ╰─────┴─────┴────────┴─────────┴─────────╯                            
              ____   &win_tl   &win_t   &win_tr   _oo_              _oo_                                   &kp LG(N1)   &kp LG(N2)     &kp LG(N3)     &kp LG(N4)   &kp LG(N5)     &kp LG(N6)
              ____   &win_l    &win_c   &win_r    &kp LA(TAB)       _oo_                                   &kp LG(H)    &kp LG(J)      &kp LG(K)      &kp LG(L)    &kp LG(SEMI)   _oo_      
              ____   &win_bl   &win_b   &win_br   &kp LA(LS(TAB))   _oo_   ____   ____       ____   ____   _oo_         &kp LG(LBKT)   &kp LG(RBKT)   _oo_         _oo_           _oo_      
                                        ____      ____              ____   ____   ____       ____   ____   ____         ____           ____                                                 
			>;
		};
	};
};
