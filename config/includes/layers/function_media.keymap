/ {
	keymap {
		fn_media {
			label = "FN Media";
			bindings = <
//                ╭─────┬─────┬────────┬──────────┬──────────────┬─────╮                           ╭─────┬─────┬─────┬────┬─────┬─────╮
//                │     │ --- │ C_STOP │ C_VOL_UP │ C_PLAY_PAUSE │ --- │                           │ --- │ F7  │ F8  │ F9 │ F10 │     │
//                ├─────┼─────┼────────┼──────────┼──────────────┼─────┤                           ├─────┼─────┼─────┼────┼─────┼─────┤
//                │     │ --- │ C_PREV │ C_VOL_DN │    C_NEXT    │ --- │                           │ --- │ F4  │ F5  │ F6 │ F11 │     │
//                ├─────┼─────┼────────┼──────────┼──────────────┼─────┼─────┬─────╮   ╭─────┬─────┼─────┼─────┼─────┼────┼─────┼─────┤
//                │     │ --- │  C_RW  │  K_MUTE  │     C_FF     │ --- │     │     │   │     │     │ --- │ F1  │ F2  │ F3 │ F12 │     │
//                ╰─────┴─────┴────────┼──────────┼──────────────┼─────┼─────┼─────┤   ├─────┼─────┼─────┼─────┼─────┼────┴─────┴─────╯
//                                     │          │              │     │     │     │   │     │     │     │     │     │                 
//                                     ╰──────────┴──────────────┴─────┴─────┴─────╯   ╰─────┴─────┴─────┴─────┴─────╯                 
              ____   _oo_   &kp C_STOP   &kp C_VOL_UP   &kp C_PLAY_PAUSE   _oo_                                   _oo_   &kp F7   &kp F8   &kp F9   &kp F10   ____
              ____   _oo_   &kp C_PREV   &kp C_VOL_DN   &kp C_NEXT         _oo_                                   _oo_   &kp F4   &kp F5   &kp F6   &kp F11   ____
              ____   _oo_   &kp C_RW     &kp K_MUTE     &kp C_FF           _oo_   ____   ____       ____   ____   _oo_   &kp F1   &kp F2   &kp F3   &kp F12   ____
                                         ____           ____               ____   ____   ____       ____   ____   ____   ____     ____                            
			>;
		};
		fn_keys {
			label = "F1 - F24";
			bindings = <
//                ╭─────┬─────┬─────┬─────┬─────┬─────╮                           ╭─────┬─────┬─────┬─────┬─────┬─────╮
//                │ F13 │ F14 │ F15 │ F16 │ F17 │ F18 │                           │ F19 │ F20 │ F21 │ F22 │ F23 │ F24 │
//                ├─────┼─────┼─────┼─────┼─────┼─────┤                           ├─────┼─────┼─────┼─────┼─────┼─────┤
//                │ F1  │ F2  │ F3  │ F4  │ F5  │ F6  │                           │ F7  │ F8  │ F9  │ F10 │ F11 │ F12 │
//                ├─────┼─────┼─────┼─────┼─────┼─────┼─────┬─────╮   ╭─────┬─────┼─────┼─────┼─────┼─────┼─────┼─────┤
//                │ --- │ --- │ --- │ --- │ --- │ --- │     │     │   │     │     │ --- │ --- │ --- │ --- │ --- │ --- │
//                ╰─────┴─────┴─────┼─────┼─────┼─────┼─────┼─────┤   ├─────┼─────┼─────┼─────┼─────┼─────┴─────┴─────╯
//                                  │     │     │     │     │     │   │     │     │     │     │     │                  
//                                  ╰─────┴─────┴─────┴─────┴─────╯   ╰─────┴─────┴─────┴─────┴─────╯                  
              &kp F13   &kp F14   &kp F15   &kp F16   &kp F17   &kp F18                                   &kp F19   &kp F20   &kp F21   &kp F22   &kp F23   &kp F24
              &kp F1    &kp F2    &kp F3    &kp F4    &kp F5    &kp F6                                    &kp F7    &kp F8    &kp F9    &kp F10   &kp F11   &kp F12
              _oo_      _oo_      _oo_      _oo_      _oo_      _oo_      ____   ____       ____   ____   _oo_      _oo_      _oo_      _oo_      _oo_      _oo_   
                                            ____      ____      ____      ____   ____       ____   ____   ____      ____      ____                                 
			>;
		};
	};
};
