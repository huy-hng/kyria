/ {
    keymap {
        caps {
            label = "Caps";
            bindings = <
              ____             ____   ____   ____   ____   ____                                   ____   ____   ____   ____   ____   ____
              &mt LCTRL CAPS   ____   ____   ____   ____   ____                                   ____   ____   ____   ____   ____   ____
              ____             ____   ____   ____   ____   ____   ____   ____       ____   ____   ____   ____   ____   ____   ____   ____
                                             ____   ____   ____   ____   ____       ____   ____   ____   ____   ____
>;
        };
	};
};
