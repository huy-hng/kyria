/ {
    keymap {
        no_hold {
            label = "No Hold";
            bindings = <
//                ╭─────┬─────┬─────┬─────┬─────┬─────╮                           ╭───────────┬─────┬─────┬─────┬─────┬─────╮
//                │     │     │     │     │     │     │                           │           │     │     │     │     │     │
//                ├─────┼─────┼─────┼─────┼─────┼─────┤                           ├───────────┼─────┼─────┼─────┼─────┼─────┤
//                │  ⌃  │     │     │     │     │     │                           │           │     │     │     │     │     │
//                ├─────┼─────┼─────┼─────┼─────┼─────┼─────┬─────╮   ╭─────┬─────┼───────────┼─────┼─────┼─────┼─────┼─────┤
//                │     │     │     │     │     │     │     │     │   │     │     │           │     │     │     │     │     │
//                ╰─────┴─────┴─────┼─────┼─────┼─────┼─────┼─────┤   ├─────┼─────┼───────────┼─────┼─────┼─────┴─────┴─────╯
//                                  │     │     │  ⇧  │     │     │   │  ⏎  │  ⌫  │  SYMBOLS │     │     │                  
//                                  ╰─────┴─────┴─────┴─────┴─────╯   ╰─────┴─────┴───────────┴─────┴─────╯                  
              ____        ____   ____   ____   ____   ____                                                ____          ____   ____   ____   ____   ____
              &kp LCTRL   ____   ____   ____   ____   ____                                                ____          ____   ____   ____   ____   ____
              ____        ____   ____   ____   ____   ____         ____   ____       ____      ____       ____          ____   ____   ____   ____   ____
                                        ____   ____   &kp LSHIFT   ____   ____       &kp RET   &kp BSPC   &mo SYMBOLS   ____   ____                     
                >;
        };
    };
};
