/ {
    keymap {
        fidget {
			label = "Fidget";
			bindings = <
              _oo_   _oo_   _oo_   _oo_   _oo_   _oo_                                   _oo_   _oo_                        _oo_   _oo_   _oo_   _oo_
              _oo_   _oo_   _oo_   _oo_   _oo_   _oo_                                   _oo_   _oo_                        _oo_   _oo_   _oo_   _oo_
              _oo_   _oo_   _oo_   _oo_   _oo_   _oo_   _oo_   _oo_       _oo_   _oo_   _oo_   _oo_                        _oo_   _oo_   _oo_   _oo_
                                   _oo_   _oo_   _oo_   _oo_   _oo_       _oo_   _oo_   _oo_   &mo_menu_macro LAYER_MENU   _oo_                     
            >;
        };
    };
};
