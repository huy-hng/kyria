/ {
    keymap {
        gaming {
            label = "Gaming";
            bindings = <
//                ╭─────┬─────┬─────┬─────┬─────┬─────╮                           ╭─────┬─────┬─────┬─────┬─────┬─────╮
//                │  ⎋  │  ⭾  │  Q  │  W  │  E  │  R  │                           │  T  │  Y  │  U  │  I  │  O  │  P  │
//                ├─────┼─────┼─────┼─────┼─────┼─────┤                           ├─────┼─────┼─────┼─────┼─────┼─────┤
//                │  ⌃  │  ⇧  │  A  │  S  │  D  │  F  │                           │  G  │  H  │  J  │  K  │  L  │  ;  │
//                ├─────┼─────┼─────┼─────┼─────┼─────┼─────┬─────╮   ╭─────┬─────┼─────┼─────┼─────┼─────┼─────┼─────┤
//                │  ⎇  │  ⌃  │  Z  │  X  │  C  │  V  │     │     │   │     │     │  B  │  N  │  M  │  ,  │  .  │  /  │
//                ╰─────┴─────┴─────┼─────┼─────┼─────┼─────┼─────┤   ├─────┼─────┼─────┼─────┼─────┼─────┴─────┴─────╯
//                                  │     │     │     │  ␣  │     │   │  ⏎  │  ⌫  │     │     │     │                  
//                                  ╰─────┴─────┴─────┴─────┴─────╯   ╰─────┴─────┴─────┴─────┴─────╯                  
              &kp ESC     &kp TAB      &kp Q   &kp W   &kp E   &kp R                                               &kp T   &kp Y   &kp U   &kp I       &kp O     &kp P   
              &kp LCTRL   &kp LSHIFT   &kp A   &kp S   &kp D   &kp F                                               &kp G   &kp H   &kp J   &kp K       &kp L     &kp SEMI
              &kp LALT    &kp LCTRL    &kp Z   &kp X   &kp C   &kp V   ____        ____       ____      ____       &kp B   &kp N   &kp M   &kp COMMA   &kp DOT   &kp FSLH
                                               ____    ____    ____    &kp SPACE   ____       &kp RET   &kp BSPC   ____    ____    ____                                  
            >;
        };
        gaming_swapped {
            label = "Gaming Swapped";
            bindings = <
//                ╭─────┬─────┬─────┬─────┬─────┬─────╮                           ╭─────┬─────┬─────┬─────┬─────┬─────╮
//                │  T  │  Y  │  U  │  I  │  O  │  P  │                           │  ⭾  │  Q  │  W  │  E  │  R  │  ⎋  │
//                ├─────┼─────┼─────┼─────┼─────┼─────┤                           ├─────┼─────┼─────┼─────┼─────┼─────┤
//                │  G  │  H  │  J  │  K  │  L  │  ;  │                           │  ⇧  │  A  │  S  │  D  │  F  │  ⌃  │
//                ├─────┼─────┼─────┼─────┼─────┼─────┼─────┬─────╮   ╭─────┬─────┼─────┼─────┼─────┼─────┼─────┼─────┤
//                │  B  │  N  │  M  │  ,  │  .  │  /  │     │     │   │     │     │  ⌃  │  Z  │  X  │  C  │  V  │  ⎇  │
//                ╰─────┴─────┴─────┼─────┼─────┼─────┼─────┼─────┤   ├─────┼─────┼─────┼─────┼─────┼─────┴─────┴─────╯
//                                  │     │     │     │  ␣  │     │   │  ⏎  │  ⌫  │     │     │     │                  
//                                  ╰─────┴─────┴─────┴─────┴─────╯   ╰─────┴─────┴─────┴─────┴─────╯                  
              &kp T   &kp Y   &kp U   &kp I       &kp O     &kp P                                                  &kp TAB      &kp Q   &kp W   &kp E   &kp R   &kp ESC  
              &kp G   &kp H   &kp J   &kp K       &kp L     &kp SEMI                                               &kp LSHIFT   &kp A   &kp S   &kp D   &kp F   &kp LCTRL
              &kp B   &kp N   &kp M   &kp COMMA   &kp DOT   &kp FSLH   ____        ____       ____      ____       &kp LCTRL    &kp Z   &kp X   &kp C   &kp V   &kp LALT 
                                      ____        ____      ____       &kp SPACE   ____       &kp RET   &kp BSPC   ____         ____    ____                             
            >;
        };
    };
};
