/ {
	keymap {
		symbols {
			label = "Symbols";
			bindings = <
//                ╭─────┬────────────┬─────┬─────┬─────┬─────╮                           ╭─────┬─────┬─────┬─────┬─────┬─────╮
//                │  !  │     @      │  #  │  $  │  %  │  ^  │                           │  &  │  *  │  -  │  +  │  |  │  ~  │
//                ├─────┼────────────┼─────┼─────┼─────┼─────┤                           ├─────┼─────┼─────┼─────┼─────┼─────┤
//                │     │ &caps_word │  [  │  (  │  )  │  ]  │                           │  ?  │  .  │  _  │  :  │  /  │  `  │
//                ├─────┼────────────┼─────┼─────┼─────┼─────┼─────┬─────╮   ╭─────┬─────┼─────┼─────┼─────┼─────┼─────┼─────┤
//                │     │    ---     │  <  │  {  │  }  │  >  │     │     │   │     │     │  ¨  │  ,  │  =  │  ;  │  \  │  ?  │
//                ╰─────┴────────────┴─────┼─────┼─────┼─────┼─────┼─────┤   ├─────┼─────┼─────┼─────┼─────┼─────┴─────┴─────╯
//                                         │     │     │     │     │     │   │     │     │     │     │     │                  
//                                         ╰─────┴─────┴─────┴─────┴─────╯   ╰─────┴─────┴─────┴─────┴─────╯                  
              &kp EXCL   &kp AT       &kp POUND   &kp DLLR   &kp PRCNT   &kp CARET                                   &kp AMPS                   &kp STAR    &kp MINUS   &kp PLUS    &kp PIPE   &kp TILDE
              ____       &caps_word   &kp LBKT    &kp LPAR   &kp RPAR    &kp RBKT                                    &kp QMARK                  &kp DOT     &kp UNDER   &kp COLON   &kp FSLH   &kp GRAVE
              ____       _oo_         &kp LT      &kp LBRC   &kp RBRC    &kp GT      ____   ____       ____   ____   &kp RA(LS(SINGLE_QUOTE))   &kp COMMA   &kp EQUAL   &kp SEMI    &kp BSLH   &kp QMARK
                                                  ____       ____        ____        ____   ____       ____   ____   ____                       ____        ____                                        
			>;
		};

	};
};
