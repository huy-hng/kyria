#include "../layers/base.keymap"
#include "../layers/modes/debug.keymap"
#include "../layers/modes/caps.keymap"
#include "../layers/modes/testing.keymap"
#include "../layers/modes/qwerty.keymap"
#include "../layers/modes/fidget.keymap"
#include "../layers/modes/gaming.keymap"
#include "../layers/modes/sudoku.keymap"
#include "../layers/modes/no_hold.keymap"
#include "../layers/navipad.keymap"
#include "../layers/symbols.keymap"
#include "../layers/os_layer.keymap"
#include "../layers/function_media.keymap"
#include "../layers/settings.keymap"
#include "../layers/encoder_layers.keymap"
#include "../layers/display_menu.keymap"
