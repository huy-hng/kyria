#define TAP_DANCE(name, key1, key2)        \
name: name {                               \
	compatible = "zmk,behavior-tap-dance"; \
	label = #name;                         \
	#binding-cells = <0>;                  \
	bindings = <key1>, <key2>;             \
}

#define HOLD(name, key1, key2, ...)   \
name: name {                              \
	compatible = "zmk,behavior-hold-tap"; \
	label = #name;                        \
	#binding-cells = <2>;                 \
    tapping-term-ms = <200>;              \
	quick-tap-ms = <200>;                 \
	flavor = "hold-preferred";            \
	bindings = <key1>, <key2>;            \
	__VA_ARGS__                           \
}

#define INTERRUPT(name, key1, key2, ...)  \
name: name {                              \
	compatible = "zmk,behavior-hold-tap"; \
	label = #name;                        \
	#binding-cells = <2>;                 \
    tapping-term-ms = <300>;              \
	quick-tap-ms = <100>;                 \
	global-quick-tap;                     \
	flavor = "tap-unless-interrupted";    \
	bindings = <key1>, <key2>;            \
	__VA_ARGS__                           \
}

#define TAP(name, key1, key2, ...)   \
name: name {                              \
	compatible = "zmk,behavior-hold-tap"; \
	label = #name;                        \
	#binding-cells = <2>;                 \
    tapping-term-ms = <120>;              \
	quick-tap-ms = <150>;                 \
	global-quick-tap;                     \
	flavor = "tap-preferred";             \
	bindings = <key1>, <key2>;            \
	__VA_ARGS__                           \
}

/ {
	behaviors {
		// TAP_DANCE(capsword, &kp LSHIFT, &caps_word);

		sym_bsp: sym_bsp {
			compatible = "zmk,behavior-hold-tap";
			label = "sym_bsp";
			#binding-cells = <2>;
			tapping-term-ms = <500>;
			quick-tap-ms = <100>;
			global-quick-tap;
			flavor = "tap-unless-interrupted";
			bindings = <&mo>, <&kp>;
		};

		// skq: skq {
		// 	compatible = "zmk,behavior-sticky-key";
		// 	label = "skq";
		// 	#binding-cells = <2>;
		// 	bindings = <&kp>;
		// 	release-after-ms = <1000>;
		// 	quick-release;
		// 	ignore-modifiers;
		// };
	};
};
