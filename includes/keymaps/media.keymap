/ {
	keymap {
		media_fn {
			label = "Media FN";
			sensor-bindings = <&inc_dec_kp C_VOL_UP C_VOL_DN>;
			bindings = <
//                ┌──────┬──────┬─────────┬───────────┬───────────────┬──────┐                               ┌──────┬──────┬──────┬─────┬──────┬──────┐
//                │ ____ │ _oo_ │  C_STOP │  C_VOL_UP │  C_PLAY_PAUSE │ _oo_ │                               │ _oo_ │  F7  │  F8  │  F9 │  F10 │ ____ │
//                ├──────┼──────┼─────────┼───────────┼───────────────┼──────┤                               ├──────┼──────┼──────┼─────┼──────┼──────┤
//                │ ____ │ _oo_ │  C_PREV │  C_VOL_DN │     C_NEXT    │ _oo_ │                               │ _oo_ │  F4  │  F5  │  F6 │  F11 │ ____ │
//                ├──────┼──────┼─────────┼───────────┼───────────────┼──────┼──────┬──────┐   ┌──────┬──────┼──────┼──────┼──────┼─────┼──────┼──────┤
//                │ ____ │ _oo_ │   C_RW  │   K_MUTE  │      C_FF     │ _oo_ │ ____ │ ____ │   │ ____ │ ____ │ _oo_ │  F1  │  F2  │  F3 │  F12 │ ____ │
//                └──────┴──────┴─────────┼───────────┼───────────────┼──────┼──────┼──────┤   ├──────┼──────┼──────┼──────┼──────┼─────┴──────┴──────┘
//                                        │   ____    │     ____      │ ____ │ ____ │ ____ │   │ ____ │ ____ │ ____ │ ____ │ ____ │                    
//                                        └───────────┴───────────────┴──────┴──────┴──────┘   └──────┴──────┴──────┴──────┴──────┘                    
              ____   _oo_   &kp C_STOP   &kp C_VOL_UP   &kp C_PLAY_PAUSE   _oo_                                   _oo_   &kp F7   &kp F8   &kp F9   &kp F10   ____
              ____   _oo_   &kp C_PREV   &kp C_VOL_DN   &kp C_NEXT         _oo_                                   _oo_   &kp F4   &kp F5   &kp F6   &kp F11   ____
              ____   _oo_   &kp C_RW     &kp K_MUTE     &kp C_FF           _oo_   ____   ____       ____   ____   _oo_   &kp F1   &kp F2   &kp F3   &kp F12   ____
                                         ____           ____               ____   ____   ____       ____   ____   ____   ____     ____                            
			>;
		};
	};
};
