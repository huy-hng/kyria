/ {
    keymap {
        vim {
			label = "Vim";
			sensor-bindings = <&inc_dec_kp RIGHT LEFT>;
			bindings = <
//                ┌──────┬───────────┬───────────┬─────────┬────────────┬────────────┐                               ┌───────┬───────┬──────┬────────┬──────┬──────┐
//                │ _oo_ │   _oo_    │   _oo_    │  K_COPY │   K_PASTE  │    _oo_    │                               │ _oo_  │ _oo_  │ _oo_ │  _oo_  │ _oo_ │ _oo_ │
//                ├──────┼───────────┼───────────┼─────────┼────────────┼────────────┤                               ├───────┼───────┼──────┼────────┼──────┼──────┤
//                │ _oo_ │  LC(LEFT) │  LC(LEFT) │  _oo_   │  LC(RIGHT) │  LC(RIGHT) │                               │  LEFT │  DOWN │  UP  │  RIGHT │ _oo_ │ _oo_ │
//                ├──────┼───────────┼───────────┼─────────┼────────────┼────────────┼──────┬──────┐   ┌──────┬──────┼───────┼───────┼──────┼────────┼──────┼──────┤
//                │ _oo_ │   _oo_    │   K_CUT   │  _oo_   │    _oo_    │    _oo_    │ ____ │ ____ │   │ ____ │ ____ │ _oo_  │ _oo_  │ _oo_ │  _oo_  │ _oo_ │ _oo_ │
//                └──────┴───────────┴───────────┼─────────┼────────────┼────────────┼──────┼──────┤   ├──────┼──────┼───────┼───────┼──────┼────────┴──────┴──────┘
//                                               │  ____   │    ____    │    ____    │ ____ │ ____ │   │ ____ │ ____ │ ____  │ ____  │ ____ │                       
//                                               └─────────┴────────────┴────────────┴──────┴──────┘   └──────┴──────┴───────┴───────┴──────┘                       
              _oo_   _oo_           _oo_           &kp K_COPY   &kp K_PASTE     _oo_                                            _oo_       _oo_       _oo_     _oo_        _oo_   _oo_
              _oo_   &kp LC(LEFT)   &kp LC(LEFT)   _oo_         &kp LC(RIGHT)   &kp LC(RIGHT)                                   &kp LEFT   &kp DOWN   &kp UP   &kp RIGHT   _oo_   _oo_
              _oo_   _oo_           &kp K_CUT      _oo_         _oo_            _oo_            ____   ____       ____   ____   _oo_       _oo_       _oo_     _oo_        _oo_   _oo_
                                                   ____         ____            ____            ____   ____       ____   ____   ____       ____       ____                            
            >;
        };
    };
};
