/ {
	keymap {
		settings {
			label = "Settings";
			bindings = <
//    ┌─────────────┬───────────┬───────────┬───────────┬───────────┬───────────┐                                           ┌──────────┬──────────┬──────────────┬──────────┬──────────┬────────────┐
//    │ bootloader  │  BT_SEL 0 │  BT_SEL 1 │  BT_SEL 2 │  BT_SEL 3 │  BT_SEL 4 │                                           │  RGB_TOG │ _______  │   _______    │ _______  │ _______  │ bootloader │
//    ├─────────────┼───────────┼───────────┼───────────┼───────────┼───────────┤                                           ├──────────┼──────────┼──────────────┼──────────┼──────────┼────────────┤
//    │ out OUT_TOG │  _______  │  _______  │  _______  │  _______  │  _______  │                                           │  RGB_EFF │  RGB_BRI │    RGB_SPI   │  RGB_SAI │  RGB_HUI │  _______   │
//    ├─────────────┼───────────┼───────────┼───────────┼───────────┼───────────┼─────────┬─────────┐   ┌─────────┬─────────┼──────────┼──────────┼──────────────┼──────────┼──────────┼────────────┤
//    │    BT_CLR   │  _______  │  _______  │  _______  │  _______  │  _______  │ _______ │ _______ │   │ _______ │ _______ │  RGB_EFR │  RGB_BRD │    RGB_SPD   │  RGB_SAD │  RGB_HUD │  _______   │
//    └─────────────┴───────────┴───────────┼───────────┼───────────┼───────────┼─────────┼─────────┤   ├─────────┼─────────┼──────────┼──────────┼──────────────┼──────────┴──────────┴────────────┘
//                                          │  _______  │  _______  │  _______  │ _______ │ _______ │   │ _______ │ _______ │ _______  │ _______  │ tog SETTINGS │                                   
//                                          └───────────┴───────────┴───────────┴─────────┴─────────┘   └─────────┴─────────┴──────────┴──────────┴──────────────┘                                   
  &bootloader    &bt BT_SEL 0   &bt BT_SEL 1   &bt BT_SEL 2   &bt BT_SEL 3   &bt BT_SEL 4                                           &rgb_ug RGB_TOG   &trans            &trans            &trans            &trans            &bootloader
  &out OUT_TOG   &trans         &trans         &trans         &trans         &trans                                                 &rgb_ug RGB_EFF   &rgb_ug RGB_BRI   &rgb_ug RGB_SPI   &rgb_ug RGB_SAI   &rgb_ug RGB_HUI   &trans     
  &bt BT_CLR     &trans         &trans         &trans         &trans         &trans         &trans   &trans       &trans   &trans   &rgb_ug RGB_EFR   &rgb_ug RGB_BRD   &rgb_ug RGB_SPD   &rgb_ug RGB_SAD   &rgb_ug RGB_HUD   &trans     
                                               &trans         &trans         &trans         &trans   &trans       &trans   &trans   &trans            &trans            &tog SETTINGS                                                    
				>;
		};
	};
};

