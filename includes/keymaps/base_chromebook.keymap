/ {
    keymap {
        chromebook {
            label = "Chrome";
            bindings = <
//    ┌────────────┬────────┬────────┬────────┬────────┬────────┐                                       ┌────────┬────────┬────────┬────────┬────────┬────────┐
//    │   ______   │ ______ │ ______ │ ______ │ ______ │ ______ │                                       │ ______ │ ______ │ ______ │ ______ │ ______ │ ______ │
//    ├────────────┼────────┼────────┼────────┼────────┼────────┤                                       ├────────┼────────┼────────┼────────┼────────┼────────┤
//    │  CTRL CAPS │ ______ │ ______ │ ______ │ ______ │ ______ │                                       │ ______ │ ______ │ ______ │ ______ │ ______ │ ______ │
//    ├────────────┼────────┼────────┼────────┼────────┼────────┼────────┬────────┐   ┌────────┬────────┼────────┼────────┼────────┼────────┼────────┼────────┤
//    │   ______   │ ______ │ ______ │ ______ │ ______ │ ______ │ ______ │ ______ │   │ ______ │ ______ │ ______ │ ______ │ ______ │ ______ │ ______ │ ______ │
//    └────────────┴────────┴────────┼────────┼────────┼────────┼────────┼────────┤   ├────────┼────────┼────────┼────────┼────────┼────────┴────────┴────────┘
//                                   │ ______ │ ______ │ ______ │ ______ │ ______ │   │ ______ │ ______ │ ______ │ ______ │ ______ │                           
//                                   └────────┴────────┴────────┴────────┴────────┘   └────────┴────────┴────────┴────────┴────────┘                           
  &trans           &trans   &trans   &trans   &trans   &trans                                           &trans   &trans   &trans   &trans   &trans   &trans
  &mt LCTRL CAPS   &trans   &trans   &trans   &trans   &trans                                           &trans   &trans   &trans   &trans   &trans   &trans
  &trans           &trans   &trans   &trans   &trans   &trans   &trans   &trans       &trans   &trans   &trans   &trans   &trans   &trans   &trans   &trans
                                     &trans   &trans   &trans   &trans   &trans       &trans   &trans   &trans   &trans   &trans                           
>;
        };
	};
};
