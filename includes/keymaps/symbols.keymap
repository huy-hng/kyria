/ {
    keymap {
        symbols {
            label = "Symbols";
            bindings = <
//                ┌──────┬──────┬──────┬──────┬──────┬──────┐                               ┌────────┬──────┬──────┬──────┬──────┬──────┐
//                │   !  │   @  │   #  │   $  │   %  │   ^  │                               │   AND  │   *  │   -  │   +  │   |  │   ~  │
//                ├──────┼──────┼──────┼──────┼──────┼──────┤                               ├────────┼──────┼──────┼──────┼──────┼──────┤
//                │ ____ │  <   │   {  │   [  │   (  │ _oo_ │                               │    ?   │   .  │   _  │   :  │   /  │   `  │
//                ├──────┼──────┼──────┼──────┼──────┼──────┼──────┬──────┐   ┌──────┬──────┼────────┼──────┼──────┼──────┼──────┼──────┤
//                │ ____ │  >   │   }  │   ]  │   )  │ _oo_ │ ____ │ ____ │   │ ____ │ ____ │  _oo_  │   ,  │   =  │   ;  │   \  │   ?  │
//                └──────┴──────┴──────┼──────┼──────┼──────┼──────┼──────┤   ├──────┼──────┼────────┼──────┼──────┼──────┴──────┴──────┘
//                                     │ ____ │ ____ │ ____ │ ____ │ ____ │   │ ____ │ ____ │  ____  │ ____ │ ____ │                     
//                                     └──────┴──────┴──────┴──────┴──────┘   └──────┴──────┴────────┴──────┴──────┘                     
              &kp EXCL   &kp AT   &kp POUND   &kp DLLR   &kp PRCNT   &kp CARET                                   &kp AMPS    &kp STAR    &kp MINUS   &kp PLUS    &kp PIPE   &kp TILDE
              ____       &kp LT   &kp LBRC    &kp LBKT   &kp LPAR    _oo_                                        &kp QMARK   &kp DOT     &kp UNDER   &kp COLON   &kp FSLH   &kp GRAVE
              ____       &kp GT   &kp RBRC    &kp RBKT   &kp RPAR    _oo_        ____   ____       ____   ____   _oo_        &kp COMMA   &kp EQUAL   &kp SEMI    &kp BSLH   &kp QMARK
                                              ____       ____        ____        ____   ____       ____   ____   ____        ____        ____                                        
            >;
        };
    };
};
