/ {
    keymap {
        navipad {
			label = "Navipad";
			sensor-bindings = <&inc_dec_kp RIGHT LEFT>;
			bindings = <
//                ┌──────┬─────────┬────────┬─────────┬──────────┬────────┐                                        ┌──────┬──────┬──────┬──────┬──────┬───────┐
//                │ ____ │  _oo_   │  HOME  │    UP   │    END   │  PG_UP │                                        │   /  │   7  │   8  │   9  │   *  │   %   │
//                ├──────┼─────────┼────────┼─────────┼──────────┼────────┤                                        ├──────┼──────┼──────┼──────┼──────┼───────┤
//                │ ____ │  K_UNDO │  LEFT  │   DOWN  │   RIGHT  │  PG_DN │                                        │   =  │   4  │   5  │   6  │   +  │  META │
//                ├──────┼─────────┼────────┼─────────┼──────────┼────────┼─────────┬──────┐   ┌──────┬────────────┼──────┼──────┼──────┼──────┼──────┼───────┤
//                │ ____ │  K_REDO │  K_CUT │  K_COPY │  K_PASTE │    ,   │ to BASE │ ____ │   │ ____ │ tog NUMPAD │   .  │   1  │   2  │   3  │   -  │ _oo_  │
//                └──────┴─────────┴────────┼─────────┼──────────┼────────┼─────────┼──────┤   ├──────┼────────────┼──────┼──────┼──────┼──────┴──────┴───────┘
//                                          │  ____   │   ____   │  ____  │  ____   │ ____ │   │ ____ │    ____    │   0  │ ____ │ ____ │                      
//                                          └─────────┴──────────┴────────┴─────────┴──────┘   └──────┴────────────┴──────┴──────┴──────┘                      
              ____   _oo_         &kp HOME    &kp UP       &kp END       &kp PG_UP                                              &kp FSLH    &kp N7   &kp N8   &kp N9   &kp STAR    &kp PRCNT
              ____   &kp K_UNDO   &kp LEFT    &kp DOWN     &kp RIGHT     &kp PG_DN                                              &kp EQUAL   &kp N4   &kp N5   &kp N6   &kp PLUS    &kp LMETA
              ____   &kp K_REDO   &kp K_CUT   &kp K_COPY   &kp K_PASTE   &kp COMMA   &to BASE   ____       ____   &tog NUMPAD   &kp DOT     &kp N1   &kp N2   &kp N3   &kp MINUS   _oo_     
                                              ____         ____          ____        ____       ____       ____   ____          &kp N0      ____     ____                                   
            >;
        };
        numpad_overlay {
			label = "Numpad";
			bindings = <
//                ┌──────┬──────┬──────┬──────┬──────┬──────┐                                     ┌──────┬──────┬──────┬──────┬──────┬──────┐
//                │ ____ │ ____ │ ____ │ ____ │ ____ │ ____ │                                     │ ____ │   7  │   8  │   9  │ ____ │ ____ │
//                ├──────┼──────┼──────┼──────┼──────┼──────┤                                     ├──────┼──────┼──────┼──────┼──────┼──────┤
//                │ ____ │ ____ │ ____ │ ____ │ ____ │ ____ │                                     │ ____ │   4  │   5  │   6  │ ____ │ ____ │
//                ├──────┼──────┼──────┼──────┼──────┼──────┼──────┬──────┐   ┌──────┬────────────┼──────┼──────┼──────┼──────┼──────┼──────┤
//                │ ____ │ ____ │ ____ │ ____ │ ____ │ ____ │ ____ │ ____ │   │ ____ │ tog NUMPAD │ ____ │   1  │   2  │   3  │ ____ │ ____ │
//                └──────┴──────┴──────┼──────┼──────┼──────┼──────┼──────┤   ├──────┼────────────┼──────┼──────┼──────┼──────┴──────┴──────┘
//                                     │ ____ │ ____ │ ____ │ ____ │ ____ │   │ ____ │    ____    │   0  │ ____ │ ____ │                     
//                                     └──────┴──────┴──────┴──────┴──────┘   └──────┴────────────┴──────┴──────┴──────┘                     
              ____   ____   ____   ____   ____   ____                                          ____        &kp KP_N7   &kp KP_N8   &kp KP_N9   ____   ____
              ____   ____   ____   ____   ____   ____                                          ____        &kp KP_N4   &kp KP_N5   &kp KP_N6   ____   ____
              ____   ____   ____   ____   ____   ____   ____   ____       ____   &tog NUMPAD   ____        &kp KP_N1   &kp KP_N2   &kp KP_N3   ____   ____
                                   ____   ____   ____   ____   ____       ____   ____          &kp KP_N0   ____        ____                               
            >;
        };
    };
};
