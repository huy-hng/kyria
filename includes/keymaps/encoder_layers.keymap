/ {
    keymap {
        encoder_lr {
            label = "Enc LR";
            sensor-bindings = <&inc_dec_kp RIGHT LEFT>;
            bindings = <
//                ┌──────┬──────┬──────┬──────┬──────┬──────┐                                      ┌──────┬──────┬──────┬──────┬──────┬──────┐
//                │ ____ │ ____ │ ____ │ ____ │ ____ │ ____ │                                      │ ____ │ ____ │ ____ │ ____ │ ____ │ ____ │
//                ├──────┼──────┼──────┼──────┼──────┼──────┤                                      ├──────┼──────┼──────┼──────┼──────┼──────┤
//                │ ____ │ ____ │ ____ │ ____ │ ____ │ ____ │                                      │ ____ │ ____ │ ____ │ ____ │ ____ │ ____ │
//                ├──────┼──────┼──────┼──────┼──────┼──────┼──────┬──────┐   ┌─────────────┬──────┼──────┼──────┼──────┼──────┼──────┼──────┤
//                │ ____ │ ____ │ ____ │ ____ │ ____ │ ____ │ ____ │ ____ │   │ tog ENC_TAB │ ____ │ ____ │ ____ │ ____ │ ____ │ ____ │ ____ │
//                └──────┴──────┴──────┼──────┼──────┼──────┼──────┼──────┤   ├─────────────┼──────┼──────┼──────┼──────┼──────┴──────┴──────┘
//                                     │ ____ │ ____ │ ____ │ ____ │ ____ │   │    ____     │ ____ │ ____ │ ____ │ ____ │                     
//                                     └──────┴──────┴──────┴──────┴──────┘   └─────────────┴──────┴──────┴──────┴──────┘                     
              ____   ____   ____   ____   ____   ____                                           ____   ____   ____   ____   ____   ____
              ____   ____   ____   ____   ____   ____                                           ____   ____   ____   ____   ____   ____
              ____   ____   ____   ____   ____   ____   ____   ____       &tog ENC_TAB   ____   ____   ____   ____   ____   ____   ____
                                   ____   ____   ____   ____   ____       ____           ____   ____   ____   ____                     
            >;
        };
        encoder_tab {
            label = "Enc Tab";
            sensor-bindings = <&inc_dec_kp LC(TAB) LC(LS(TAB))>;
            bindings = trans_layer;
        };
    };
};

