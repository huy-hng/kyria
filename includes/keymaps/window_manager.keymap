#define manjaro_win_dock_left &kp LC(LA(KP_N4))
#define manjaro_win_dock_center &kp LC(LA(KP_N5))
#define manjaro_win_dock_right &kp LC(LA(KP_N6))

#define chrome_desktop_left &kp LG(LBKT)
#define chrome_desktop_right &kp LG(RBKT)

// maybe this needs to be curly bracket instead of shift square bracket
#define chrome_win_desktop_left &kp LG(LS(LBKT))
#define chrome_win_desktop_right &kp LG(LS(RBKT))

#define chrome_win_switch_monitor &kp LG(LA(M))

/ {
	keymap {
		win_manager {
			label = "Window";
			bindings = <
//    ┌─────────┬─────────┬─────────┬─────────┬─────────┬─────────┐                                           ┌─────────┬──────────┬────────────┬───────────┬─────────┬─────────┐
//    │ _______ │ _______ │ _______ │ _______ │ _______ │ _______ │                                           │ _______ │ _______  │  _______   │  _______  │ _______ │ _______ │
//    ├─────────┼─────────┼─────────┼─────────┼─────────┼─────────┤                                           ├─────────┼──────────┼────────────┼───────────┼─────────┼─────────┤
//    │ _______ │ _______ │ _______ │ _______ │ _______ │ _______ │                                           │ _______ │ win_left │ win_center │ win_right │ _______ │ _______ │
//    ├─────────┼─────────┼─────────┼─────────┼─────────┼─────────┼─────────┬─────────┐   ┌─────────┬─────────┼─────────┼──────────┼────────────┼───────────┼─────────┼─────────┤
//    │ _______ │ _______ │ _______ │ _______ │ _______ │ _______ │ _______ │ _______ │   │ _______ │ _______ │ _______ │ _______  │  _______   │  _______  │ _______ │ _______ │
//    └─────────┴─────────┴─────────┼─────────┼─────────┼─────────┼─────────┼─────────┤   ├─────────┼─────────┼─────────┼──────────┼────────────┼───────────┴─────────┴─────────┘
//                                  │ _______ │ _______ │ _______ │ _______ │ _______ │   │ _______ │ _______ │ _______ │ _______  │  _______   │                                
//                                  └─────────┴─────────┴─────────┴─────────┴─────────┘   └─────────┴─────────┴─────────┴──────────┴────────────┘                                
  &trans   &trans   &trans   &trans   &trans   &trans                                           &trans   &trans      chrome_win_switch_monitor        &trans       &trans   &trans
  &trans   &trans   &trans   &trans   &trans   &trans                                           chrome_win_desktop_left   chrome_desktop_left   chrome_desktop_right   chrome_win_desktop_right   &trans   &trans
  &trans   &trans   &trans   &trans   &trans   &trans   &trans   &trans       &trans   &trans   &trans   &trans      &trans        &trans       &trans   &trans
                             &trans   &trans   &trans   &trans   &trans       &trans   &trans   &trans   &trans      &trans                                    
			>;
		};
	};
};

