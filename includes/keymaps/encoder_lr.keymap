/ {
    keymap {
        encoder_lr {
            label = "Encoder";
            sensor-bindings = <&inc_dec_kp RIGHT LEFT>;
            bindings = <
//    ┌──────┬──────┬──────┬──────┬──────┬──────┐                               ┌──────┬──────┬──────┬──────┬──────┬──────┐
//    │ ____ │ ____ │ ____ │ ____ │ ____ │ ____ │                               │ ____ │ ____ │ ____ │ ____ │ ____ │ ____ │
//    ├──────┼──────┼──────┼──────┼──────┼──────┤                               ├──────┼──────┼──────┼──────┼──────┼──────┤
//    │ ____ │ ____ │ ____ │ ____ │ ____ │ ____ │                               │ ____ │ ____ │ ____ │ ____ │ ____ │ ____ │
//    ├──────┼──────┼──────┼──────┼──────┼──────┼──────┬──────┐   ┌──────┬──────┼──────┼──────┼──────┼──────┼──────┼──────┤
//    │ ____ │ ____ │ ____ │ ____ │ ____ │ ____ │ ____ │ ____ │   │ ____ │ ____ │ ____ │ ____ │ ____ │ ____ │ ____ │ ____ │
//    └──────┴──────┴──────┼──────┼──────┼──────┼──────┼──────┤   ├──────┼──────┼──────┼──────┼──────┼──────┴──────┴──────┘
//                         │ ____ │ ____ │ ____ │ ____ │ ____ │   │ ____ │ ____ │ ____ │ ____ │ ____ │                     
//                         └──────┴──────┴──────┴──────┴──────┘   └──────┴──────┴──────┴──────┴──────┘                     
  ____   ____   ____   ____   ____   ____                                   ____   ____   ____   ____   ____   ____
  ____   ____   ____   ____   ____   ____                                   ____   ____   ____   ____   ____   ____
  ____   ____   ____   ____   ____   ____   ____   ____       ____   ____   ____   ____   ____   ____   ____   ____
                       ____   ____   ____   ____   ____       ____   ____   ____   ____   ____                     
            >;
        };
    };
};

