/ {
	keymap {
		fn_keys {
			label = "FN-Keys";
			bindings = <
//    ┌──────┬──────┬──────┬────────┬────────┬────────┐                                       ┌────────┬────────┬────────┬──────┬──────┬──────┐
//    │  F13 │  F14 │  F15 │   F16  │   F17  │   F18  │                                       │   F19  │   F20  │   F21  │  F22 │  F23 │  F24 │
//    ├──────┼──────┼──────┼────────┼────────┼────────┤                                       ├────────┼────────┼────────┼──────┼──────┼──────┤
//    │  F1  │  F2  │  F3  │   F4   │   F5   │   F6   │                                       │   F7   │   F8   │   F9   │  F10 │  F11 │  F12 │
//    ├──────┼──────┼──────┼────────┼────────┼────────┼────────┬────────┐   ┌────────┬────────┼────────┼────────┼────────┼──────┼──────┼──────┤
//    │  N1  │  N2  │  N3  │   N4   │   N5   │   N6   │ ______ │ ______ │   │ ______ │ ______ │   N7   │   N8   │   N9   │  N0  │   -  │   =  │
//    └──────┴──────┴──────┼────────┼────────┼────────┼────────┼────────┤   ├────────┼────────┼────────┼────────┼────────┼──────┴──────┴──────┘
//                         │ ______ │ ______ │ ______ │ ______ │ ______ │   │ ______ │ ______ │ ______ │ ______ │ ______ │
//                         └────────┴────────┴────────┴────────┴────────┘   └────────┴────────┴────────┴────────┴────────┘
  &kp F13   &kp F14   &kp F15   &kp F16   &kp F17   &kp F18                                           &kp F19   &kp F20   &kp F21   &kp F22   &kp F23     &kp F24  
  &kp F1    &kp F2    &kp F3    &kp F4    &kp F5    &kp F6                                            &kp F7    &kp F8    &kp F9    &kp F10   &kp F11     &kp F12  
  &kp N1    &kp N2    &kp N3    &kp N4    &kp N5    &kp N6    &trans   &trans       &trans   &trans   &kp N7    &kp N8    &kp N9    &kp N0    &kp MINUS   &kp EQUAL
                                &trans    &trans    &trans    &trans   &trans       &trans   &trans   &trans    &trans    &trans
			>;
		};
		// fn_keys {
		// 	label = "FN-Keys";
		// 	bindings = <
		// 		&trans   &kp C_RW   &kp C_STOP   &kp C_VOL_UP   &kp C_PLAY_PAUSE   &kp C_FF                                                         &trans   &kp F7   &kp F8   &kp F9   &kp F10   &kp F13
		// 		&trans   &trans     &kp C_PREV   &kp C_VOL_DN   &kp C_NEXT         &kp C_BACKLIGHT_TOGGLE                                           &trans   &kp F4   &kp F5   &kp F6   &kp F11   &kp F14
		// 		&trans   &trans     &trans       &kp K_MUTE     &kp C_BRI_DN       &kp C_BRI_UP             &trans   &trans       &trans   &trans   &trans   &kp F1   &kp F2   &kp F3   &kp F12   &kp F15
		// 		&trans         &trans             &trans                   &trans   &trans       &trans   &trans   &trans   &trans   &trans                             
		// 		>;
		// };
	};
};

