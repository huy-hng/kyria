/ {
    keymap {
        no_hold {
            label = "No Hold";
            bindings = <
//                ┌────────────┬──────┬──────┬──────┬──────┬─────────────┐                                  ┌────────────┬──────┬──────┬──────┬──────┬──────┐
//                │    ____    │ ____ │ ____ │ ____ │ ____ │    ____     │                                  │    ____    │ ____ │ ____ │ ____ │ ____ │ ____ │
//                ├────────────┼──────┼──────┼──────┼──────┼─────────────┤                                  ├────────────┼──────┼──────┼──────┼──────┼──────┤
//                │ ctrl_color │ ____ │ ____ │ ____ │ ____ │    ____     │                                  │    ____    │ ____ │ ____ │ ____ │ ____ │ ____ │
//                ├────────────┼──────┼──────┼──────┼──────┼─────────────┼──────┬──────┐   ┌────────┬───────┼────────────┼──────┼──────┼──────┼──────┼──────┤
//                │    ____    │ ____ │ ____ │ ____ │ ____ │    ____     │ ____ │ ____ │   │  ____  │ ____  │    ____    │ ____ │ ____ │ ____ │ ____ │ ____ │
//                └────────────┴──────┴──────┼──────┼──────┼─────────────┼──────┼──────┤   ├────────┼───────┼────────────┼──────┼──────┼──────┴──────┴──────┘
//                                           │ ____ │ ____ │ shift_color │ ____ │ ____ │   │  enter │  BSPC │ mo_SYMBOLS │ ____ │ ____ │                     
//                                           └──────┴──────┴─────────────┴──────┴──────┘   └────────┴───────┴────────────┴──────┴──────┘                     
              ____          ____   ____   ____   ____   ____                                                  ____          ____   ____   ____   ____   ____
              &ctrl_color   ____   ____   ____   ____   ____                                                  ____          ____   ____   ____   ____   ____
              ____          ____   ____   ____   ____   ____           ____   ____       ____      ____       ____          ____   ____   ____   ____   ____
                                          ____   ____   &shift_color   ____   ____       &kp RET   &kp BSPC   &mo_SYMBOLS   ____   ____                     
                >;
        };
    };
};
