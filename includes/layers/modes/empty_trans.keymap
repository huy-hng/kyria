/ {
    keymap {
        RENAME_ME {
			label = "NAME";
			bindings = <
                ____   ____   ____   ____   ____   ____                                   ____   ____   ____   ____   ____   ____
                ____   ____   ____   ____   ____   ____                                   ____   ____   ____   ____   ____   ____
                ____   ____   ____   ____   ____   ____   ____   ____       ____   ____   ____   ____   ____   ____   ____   ____
                                     ____   ____   ____   ____   ____       ____   ____   ____   ____   ____
            >;
        };
    };
};
