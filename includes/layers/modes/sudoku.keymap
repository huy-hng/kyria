/ {
    keymap {
        sudoku {
			label = "Sudoku";
			bindings = <
//                ┌────────────┬──────┬──────┬──────┬──────┬─────────┐                                       ┌──────┬──────┬──────┬──────┬──────┬──────┐
//                │    ____    │ _oo_ │   7  │   8  │   9  │    Z    │                                       │ ____ │ ____ │ ____ │ ____ │ ____ │ ____ │
//                ├────────────┼──────┼──────┼──────┼──────┼─────────┤                                       ├──────┼──────┼──────┼──────┼──────┼──────┤
//                │ ctrl_color │   0  │   4  │   5  │   6  │    X    │                                       │ ____ │ ____ │ ____ │ ____ │ ____ │ ____ │
//                ├────────────┼──────┼──────┼──────┼──────┼─────────┼────────────┬────────┐   ┌──────┬──────┼──────┼──────┼──────┼──────┼──────┼──────┤
//                │    ____    │   0  │   1  │   2  │   3  │    C    │    BSPC    │    V   │   │ ____ │ ____ │ ____ │ ____ │ ____ │ ____ │ ____ │ ____ │
//                └────────────┴──────┴──────┼──────┼──────┼─────────┼────────────┼────────┤   ├──────┼──────┼──────┼──────┼──────┼──────┴──────┴──────┘
//                                           │ ____ │ ____ │  LSHIFT │ ctrl_color │  SPACE │   │ ____ │ ____ │ ____ │ ____ │ ____ │                     
//                                           └──────┴──────┴─────────┴────────────┴────────┘   └──────┴──────┴──────┴──────┴──────┘                     
              ____          _oo_        &kp KP_N7   &kp KP_N8   &kp KP_N9   &kp Z                                                    ____   ____   ____   ____   ____   ____
              &ctrl_color   &kp KP_N0   &kp KP_N4   &kp KP_N5   &kp KP_N6   &kp X                                                    ____   ____   ____   ____   ____   ____
              ____          &kp KP_N0   &kp KP_N1   &kp KP_N2   &kp KP_N3   &kp C        &kp BSPC      &kp V           ____   ____   ____   ____   ____   ____   ____   ____
                                                    &kp LC(Z)        &kp LC(Y)        &kp LSHIFT   &ctrl_color   &kp SPACE       ____   ____   ____   ____   ____                     
            >;
        };
    };
};
