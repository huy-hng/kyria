/ {
    keymap {
        gaming {
            label = "Gaming";
            bindings = <
//                ┌────────────┬──────┬────┬──────┬──────┬──────┐                                    ┌────────────┬──────┬──────┬──────┬──────┬──────┐
//                │     TAB    │ _oo_ │  Q │   W  │   E  │   R  │                                    │      T     │   Y  │   U  │   I  │   O  │   P  │
//                ├────────────┼──────┼────┼──────┼──────┼──────┤                                    ├────────────┼──────┼──────┼──────┼──────┼──────┤
//                │ ctrl_color │ _oo_ │  A │   S  │   D  │   F  │                                    │      G     │   H  │   J  │   K  │   L  │   ;  │
//                ├────────────┼──────┼────┼──────┼──────┼──────┼────────┬──────┐   ┌────────┬───────┼────────────┼──────┼──────┼──────┼──────┼──────┤
//                │     ALT    │ _oo_ │  Z │   X  │   C  │   V  │  ____  │ ____ │   │  ____  │ ____  │      B     │   N  │   M  │   ,  │   .  │   /  │
//                └────────────┴──────┴────┼──────┼──────┼──────┼────────┼──────┤   ├────────┼───────┼────────────┼──────┼──────┼──────┴──────┴──────┘
//                                         │ ____ │ ____ │ ____ │  SPACE │ ____ │   │  enter │  BSPC │ mo SYMBOLS │ ____ │ ____ │                     
//                                         └──────┴──────┴──────┴────────┴──────┘   └────────┴───────┴────────────┴──────┴──────┘                     
              &kp TAB       _oo_   &kp Q   &kp W   &kp E   &kp R                                               &kp T         &kp Y   &kp U   &kp I       &kp O     &kp P   
              &ctrl_color   _oo_   &kp A   &kp S   &kp D   &kp F                                               &kp G         &kp H   &kp J   &kp K       &kp L     &kp SEMI
              &kp LALT      _oo_   &kp Z   &kp X   &kp C   &kp V   ____        ____       ____      ____       &kp B         &kp N   &kp M   &kp COMMA   &kp DOT   &kp FSLH
                                           ____    ____    &kp LSHIFT    &kp SPACE   ____       &kp RET   &kp BSPC   &mo SYMBOLS   ____    ____                                  
                >;
        };
    };
};
