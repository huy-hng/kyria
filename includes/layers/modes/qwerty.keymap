/ {
    keymap {
        qwerty {
            label = "qwerty";
            sensor-bindings = <&inc_dec_kp DOWN UP>;
            bindings = <
//                ┌───────┬────┬────┬───────┬───────┬───────┐                                   ┌───────┬───────┬───────┬──────┬──────┬───────┐
//                │ trans │  Q │  W │   E   │   R   │   T   │                                   │   Y   │   U   │   I   │   O  │   P  │ trans │
//                ├───────┼────┼────┼───────┼───────┼───────┤                                   ├───────┼───────┼───────┼──────┼──────┼───────┤
//                │ trans │  A │  S │   D   │   F   │   G   │                                   │   H   │   J   │   K   │   L  │   ;  │ trans │
//                ├───────┼────┼────┼───────┼───────┼───────┼───────┬───────┐   ┌───────┬───────┼───────┼───────┼───────┼──────┼──────┼───────┤
//                │ trans │  Z │  X │   C   │   V   │   B   │ trans │ trans │   │ trans │ trans │   N   │   M   │   ,   │   .  │   /  │ trans │
//                └───────┴────┴────┼───────┼───────┼───────┼───────┼───────┤   ├───────┼───────┼───────┼───────┼───────┼──────┴──────┴───────┘
//                                  │ trans │ trans │ trans │ trans │ trans │   │ trans │ trans │ trans │ trans │ trans │                      
//                                  └───────┴───────┴───────┴───────┴───────┘   └───────┴───────┴───────┴───────┴───────┘                      
              &trans   &kp Q   &kp W   &kp E    &kp R    &kp T                                            &kp Y    &kp U    &kp I       &kp O     &kp P      &trans
              &trans   &kp A   &kp S   &kp D    &kp F    &kp G                                            &kp H    &kp J    &kp K       &kp L     &kp SEMI   &trans
              &trans   &kp Z   &kp X   &kp C    &kp V    &kp B    &trans   &trans       &trans   &trans   &kp N    &kp M    &kp COMMA   &kp DOT   &kp FSLH   &trans
                                       &trans   &trans   &trans   &trans   &trans       &trans   &trans   &trans   &trans   &trans                                 
                >;
        };
    };
};
