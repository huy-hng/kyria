/ {
    keymap {
        navipad {
			label = "Navipad";
			sensor-bindings = <&inc_dec_kp RIGHT LEFT>;
			bindings = <
//                ╭─────┬────────┬───────┬────────┬─────────┬───────╮                                     ╭─────┬─────┬─────┬─────┬─────┬─────╮
//                │     │  ---   │ HOME  │   UP   │   END   │ PG_UP │                                     │ --- │  7  │  8  │  9  │ --- │ --- │
//                ├─────┼────────┼───────┼────────┼─────────┼───────┤                                     ├─────┼─────┼─────┼─────┼─────┼─────┤
//                │     │ K_UNDO │ LEFT  │  DOWN  │  RIGHT  │ PG_DN │                                     │ --- │  4  │  5  │  6  │  0  │  ◆  │
//                ├─────┼────────┼───────┼────────┼─────────┼───────┼──────────┬─────╮   ╭─────┬──────────┼─────┼─────┼─────┼─────┼─────┼─────┤
//                │     │ K_REDO │ K_CUT │ K_COPY │ K_PASTE │   ,   │ &to_BASE │     │   │     │  NUMPAD │ --- │  1  │  2  │  3  │ --- │ --- │
//                ╰─────┴────────┴───────┼────────┼─────────┼───────┼──────────┼─────┤   ├─────┼──────────┼─────┼─────┼─────┼─────┴─────┴─────╯
//                                       │        │         │       │          │     │   │     │          │  0  │     │     │                  
//                                       ╰────────┴─────────┴───────┴──────────┴─────╯   ╰─────┴──────────┴─────┴─────┴─────╯                  
              ____   _oo_         &kp HOME    &kp UP       &kp END       &kp PG_UP                                              _oo_     &kp N7   &kp N8   &kp N9   _oo_     _oo_     
              ____   &kp K_UNDO   &kp LEFT    &kp DOWN     &kp RIGHT     &kp PG_DN                                              _oo_     &kp N4   &kp N5   &kp N6   &kp N0   &kp LMETA
              ____   &kp K_REDO   &kp K_CUT   &kp C_AC_COPY   &kp C_AC_PASTE   &kp COMMA   &to_BASE   ____       ____   &tog NUMPAD   _oo_     &kp N1   &kp N2   &kp N3   _oo_     _oo_     
                                              ____         ____          ____        ____       ____       ____   ____          &kp N0   ____     ____                                
            >;
        };
        numpad_overlay {
			label = "Numpad";
			bindings = <
//                ╭─────┬─────┬─────┬─────┬─────┬─────╮                                ╭─────┬─────┬─────┬─────┬─────┬─────╮
//                │     │     │     │     │     │     │                                │     │  7  │  8  │  9  │     │     │
//                ├─────┼─────┼─────┼─────┼─────┼─────┤                                ├─────┼─────┼─────┼─────┼─────┼─────┤
//                │     │     │     │     │     │     │                                │     │  4  │  5  │  6  │     │     │
//                ├─────┼─────┼─────┼─────┼─────┼─────┼─────┬─────╮   ╭─────┬──────────┼─────┼─────┼─────┼─────┼─────┼─────┤
//                │     │     │     │     │     │     │     │     │   │     │  NUMPAD │     │  1  │  2  │  3  │     │     │
//                ╰─────┴─────┴─────┼─────┼─────┼─────┼─────┼─────┤   ├─────┼──────────┼─────┼─────┼─────┼─────┴─────┴─────╯
//                                  │     │     │     │     │     │   │     │          │  0  │     │     │                  
//                                  ╰─────┴─────┴─────┴─────┴─────╯   ╰─────┴──────────┴─────┴─────┴─────╯                  
              ____   ____   ____   ____   ____   ____                                          ____        &kp KP_N7   &kp KP_N8   &kp KP_N9   ____   ____
              ____   ____   ____   ____   ____   ____                                          ____        &kp KP_N4   &kp KP_N5   &kp KP_N6   ____   ____
              ____   ____   ____   ____   ____   ____   ____   ____       ____   &tog NUMPAD   ____        &kp KP_N1   &kp KP_N2   &kp KP_N3   ____   ____
                                   ____   ____   ____   ____   ____       ____   ____          &kp KP_N0   ____        ____                               
            >;
        };
    };
};
