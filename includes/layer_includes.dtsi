#include "layers/base.keymap"
#include "layers/base_caps.keymap"
#include "layers/base_qwerty.keymap"
#include "layers/navipad.keymap"
#include "layers/vim.keymap"
#include "layers/symbols.keymap"
#include "layers/os_layer.keymap"
#include "layers/media.keymap"
#include "layers/fn_keys.keymap"
#include "layers/settings.keymap"
#include "layers/sticky_layers.keymap"
#include "layers/encoder_layers.keymap"
