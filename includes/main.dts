#include <behaviors.dtsi>
#include <dt-bindings/zmk/keys.h>
#include <dt-bindings/zmk/bt.h>
#include <dt-bindings/zmk/rgb.h>
#include <dt-bindings/zmk/outputs.h>
#include <dt-bindings/zmk/ext_power.h>

#include "defines.dtsi"
#include "define_layers.dtsi"

#include "macros.dtsi"
#include "combos.dtsi"
#include "mod_morphs.dtsi"
#include "tap_dances.dtsi"

#include "include_layers.dtsi"
#include "include_combos.dtsi"


&sl {
    release-after-ms = <200>;
};

&lt {
    tapping-term-ms = <200>;
    flavor = "hold-preferred";
    quick-tap-ms = <200>;
};
